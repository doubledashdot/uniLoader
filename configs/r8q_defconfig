## configs/r8q_defconfig
```kconfig
CONFIG_SM8250=y
CONFIG_SIMPLE_FB=y
CONFIG_SAMSUNG_R8Q=y
CONFIG_LINUX_KRNL_HEADER_IMG=y
CONFIG_TEXT_BASE=0x80008000
CONFIG_PAYLOAD_ENTRY=0x90000000
CONFIG_RAMDISK_ENTRY=0x86000000
```
